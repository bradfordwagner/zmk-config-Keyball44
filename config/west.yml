## config/west.yml
```yaml
manifest:
  remotes:
    - name: zmkfirmware
      url-base: https://github.com/zmkfirmware
    - name: kumamuk-git
      url-base: https://github.com/kumamuk-git
    - name: bradfordwagner
      url-base: https://github.com/bradfordwagner
  projects:
    - name: zmk
      remote: zmkfirmware
      revision: v0.2
      import: app/west.yml
    - name: zmk-pmw3610-driver
      remote: bradfordwagner
      revision: main
  self:
    path: config
```
